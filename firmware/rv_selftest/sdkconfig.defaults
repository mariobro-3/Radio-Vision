## firmware/rv_sounder/main/Kconfig.projbuild
```kconfig
menu "RadioVision sounder"

    choice RV_ILLUM
        prompt "Illumination source"
        default RV_ILLUM_RAW_DAC
        help
            RAW_DAC: maximum-performance raw-IQ sounding via the radio's baseband
            DAC (keyed spread spectrum, processing gain). Open-air transmit needs
            an amateur licence or a dummy load / shielded setup - see
            docs/COMPLIANCE.md.
            WIFI_CERTIFIED: the FCC-in-grant path. TX sends probe frames through
            the certified Wi-Fi radio; RX senses via Wi-Fi CSI with the same
            gain-invariant detector. Standard-CSI-class performance.

        config RV_ILLUM_RAW_DAC
            bool "RAW_DAC (raw-IQ, max performance)"
        config RV_ILLUM_WIFI
            bool "WIFI_CERTIFIED (certified Wi-Fi path, FCC-friendly)"
    endchoice

    config RV_PROBE_HZ
        int "WIFI_CERTIFIED: probe frame rate (Hz)"
        depends on RV_ILLUM_WIFI
        range 10 500
        default 200

    choice RV_ROLE
        prompt "Board role"
        default RV_ROLE_RX
        help
            TX: continuously replay the sounding waveform (the illuminator).
            RX: capture bursts and run the motion detector (the sensor).
            Use two boards, one of each, for the bistatic link.

        config RV_ROLE_TX
            bool "TX illuminator"
        config RV_ROLE_RX
            bool "RX sensor"
    endchoice

    config RV_CHANNEL
        int "Wi-Fi channel (1-13)"
        range 1 13
        default 1

    config RV_ZC_N
        int "Sounding code length N (Zadoff-Chu, prime)"
        default 509

    config RV_ROOT_FROM_MAC
        bool "TX: auto-assign the code root from this board's MAC"
        default y
        help
            Each illuminator derives its own Zadoff-Chu root from its MAC, so a
            mesh self-assigns near-orthogonal codes with no coordination. Turn off
            to use the fixed RV_ZC_U below.

    config RV_ZC_U
        int "Sounding code root u (used when not auto-assigned; gcd(u,N)=1)"
        default 25

    config RV_RX_ROOTS
        string "RX: comma-separated code roots to track (one link per root)"
        default "25"
        help
            The RX separates these simultaneous illuminators by correlation
            (CDMA): one independent channel/link per root, from each capture.
            List the roots your TX boards use (see each TX board's boot log).

    config RV_MAX_LINKS
        int "RX: maximum simultaneous links"
        range 1 16
        default 8

    config RV_PERIODS
        int "Periods integrated per RX burst (R)"
        default 8

    config RV_RX_GAIN
        int "Fixed RX gain index (0-82, -1 = AGC)"
        range -1 82
        default 40

    comment "--- Compliance (see docs/COMPLIANCE.md) ---"

    config RV_TX_ACK
        bool "RAW_DAC transmit: I am licensed (amateur) or using a dummy load / shield"
        depends on RV_ILLUM_RAW_DAC && RV_ROLE_TX
        default n
        help
            The raw-IQ transmitter operates outside the module's FCC grant. It is
            only enabled when you confirm here that you are either licensed for the
            13 cm amateur band or transmitting into a dummy load / shielded
            enclosure. Left off, the TX board idles instead of radiating. The
            keyed spreading code (sounding waveform) is always allowed; this gate
            is only about emitting it over the air.

    config RV_HAM_CALLSIGN
        string "Amateur call sign for station ID (RAW_DAC over-air)"
        depends on RV_ILLUM_RAW_DAC && RV_ROLE_TX
        default ""
        help
            Part 97 requires you to identify your station. This is logged as a
            reminder; you remain responsible for transmitting your ID.

    config RV_PAYLOAD_ENCRYPT
        bool "Encrypt the probe data payload (Part 15 / WIFI_CERTIFIED only)"
        depends on RV_ILLUM_WIFI
        default n
        help
            Encrypts the probe frame payload with a keystream. Only available in
            the certified Wi-Fi (Part 15) mode: Part 97 section 97.113 forbids
            obscuring the meaning of a message on amateur bands, so this cannot be
            selected in RAW_DAC. The keyed SPREADING code is not affected - it is
            a spread-spectrum sounding sequence, not message encryption, and stays
            on in every mode.

    config RV_PAYLOAD_KEY
        string "Payload encryption key"
        depends on RV_PAYLOAD_ENCRYPT
        default "radiovision"

endmenu
```

## firmware/wifi-sonar-ap/Kconfig.projbuild
```kconfig
menu "WiFi Sonar AP Settings"

config WIFI_SONAR_AP_SSID
    string "SoftAP SSID"
    default "sonar-ap-20mhz"
    help
        SSID advertised by the QT Py soft AP. Thesis p. 122 recommends a
        distinct SSID per sensing cell to avoid roaming jitter.

config WIFI_SONAR_AP_PASSWORD
    string "SoftAP password (>=8 chars)"
    default "sonarCSI2025"
    help
        WPA2 password. Use at least 8 ASCII chars.

config WIFI_SONAR_CHANNEL
    int "Primary channel (1 or 6 recommended)"
    range 1 11
    default 6
    help
        Fix channel to 1 or 6 to maintain 20 MHz bandwidth (Thesis p. 64).

config WIFI_SONAR_LINK_RATE_HZ
    int "Per-link ping rate (Hz)"
    range 50 200
    default 120
    help
        Stable range per Thesis p. 141: 100–150 Hz per link.

config WIFI_SONAR_TARGET_PORT
    int "UDP target port on STAs"
    range 1024 65535
    default 3333

config WIFI_SONAR_STA_COUNT
    int "Number of STA nodes to schedule"
    range 1 4
    default 4

config WIFI_SONAR_STA0_IP
    string "STA0 IPv4 address"
    default "192.168.4.2"
config WIFI_SONAR_STA1_IP
    string "STA1 IPv4 address"
    default "192.168.4.3"
config WIFI_SONAR_STA2_IP
    string "STA2 IPv4 address"
    default "192.168.4.4"
config WIFI_SONAR_STA3_IP
    string "STA3 IPv4 address"
    default "192.168.4.5"

config WIFI_SONAR_PING_PAYLOAD_BYTES
    int "Payload bytes per ping"
    range 16 256
    default 64

endmenu
```

## firmware/wifi-sonar-ap/sdkconfig.defaults
```kconfig
CONFIG_FREERTOS_HZ=1000
CONFIG_LWIP_MAX_SOCKETS=12
CONFIG_TCP_MAXRTX=12
CONFIG_TCP_SYNMAXRTX=6
CONFIG_ESP32_WIFI_STATIC_RX_BUFFER_NUM=16
CONFIG_ESP32_WIFI_DYNAMIC_TX_BUFFER_NUM=64
CONFIG_ESP32_WIFI_RX_BA_WIN=16
CONFIG_ESP32_WIFI_ENABLE_WPA3_SAE=y
CONFIG_ESP32_WIFI_NVS_ENABLED=y
CONFIG_ESP32_PHY_MAX_WIFI_TX_POWER=20
CONFIG_ESP_TLS_USING_MBEDTLS=y
CONFIG_COMPILER_OPTIMIZATION_PERF=y
CONFIG_ESPTOOLPY_FLASHSIZE_16MB=y
```

## firmware/wifi-sonar-sta/Kconfig.projbuild
```kconfig
menu "WiFi Sonar STA Settings"

config WIFI_SONAR_STA_LABEL
    string "Station label (matches diagram)"
    default "S1"

config WIFI_SONAR_AP_SSID
    string "Target AP SSID"
    default "sonar-ap-20mhz"

config WIFI_SONAR_AP_PASSWORD
    string "Target AP password"
    default "sonarCSI2025"

config WIFI_SONAR_STATIC_IP
    string "Static IPv4 (leave 0.0.0.0 for DHCP)"
    default "192.168.4.2"

config WIFI_SONAR_STATIC_GW
    string "Gateway IPv4 (SoftAP IPv4)"
    default "192.168.4.1"

config WIFI_SONAR_STATIC_NETMASK
    string "Netmask"
    default "255.255.255.0"

config WIFI_SONAR_COLLECTOR_IP
    string "Collector IPv4 (Windows host)"
    default "192.168.4.10"

config WIFI_SONAR_COLLECTOR_PORT
    int "Collector UDP port"
    range 1024 65535
    default 40123

config WIFI_SONAR_SAMPLE_QUEUE_DEPTH
    int "CSI queue depth"
    range 8 128
    default 32

endmenu
```

## firmware/wifi-sonar-sta/sdkconfig.defaults
```kconfig
CONFIG_FREERTOS_HZ=1000
CONFIG_LWIP_MAX_SOCKETS=16
CONFIG_TCP_MAXRTX=12
CONFIG_TCP_SYNMAXRTX=6
CONFIG_ESP32_WIFI_CSI_ENABLED=y
CONFIG_ESP32_WIFI_STATIC_RX_BUFFER_NUM=16
CONFIG_ESP32_WIFI_DYNAMIC_RX_BUFFER_NUM=64
CONFIG_ESP32_WIFI_DYNAMIC_TX_BUFFER_NUM=64
CONFIG_ESP32_WIFI_RX_BA_WIN=16
CONFIG_ESPTOOLPY_FLASHSIZE_16MB=y
CONFIG_COMPILER_OPTIMIZATION_PERF=y
```
